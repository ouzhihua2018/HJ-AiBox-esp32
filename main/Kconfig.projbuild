## main/Kconfig.projbuild
```kconfig
menu "Daa Voice Terminal"

config DAA_BRINGUP_GATE
    int "Bring-up gate (0-6 stop there, 7=normal product)"
    default 1
    range 0 7
    help
        0 = 只上电量电压，RESET 保持低。
        1 = 出 PCLK 后复位，SPI 读寄存器（默认，PCB 首测）。
        2 = Gate1 通过后再做 PDL=1 数字回环（1 kHz，不插电话线）。
        3-6 = 后续关卡，未实现时停在已完成的最后一关。
        7 = 正常连云产品路径。

config OTA_URL
    string "Default OTA URL"
    default "https://api.tenclass.net/xiaozhi/ota/"
    help
        OTA check URL used to fetch firmware metadata and MQTT/WebSocket endpoints.

choice
    prompt "Default Language"
    default LANGUAGE_ZH_CN
    help
        Log / Wi-Fi AP language

    config LANGUAGE_ZH_CN
        bool "Chinese"
endchoice

config USE_SERVER_AEC
    bool "Enable Server-Side AEC timestamps"
    default n
    help
        Attach playback timestamps for server-side AEC.

config USE_AUDIO_DEBUGGER
    bool "Enable Audio Debugger"
    default n
    help
        Send uplink PCM over UDP for bring-up.

config AUDIO_DEBUG_UDP_SERVER
    string "Audio Debug UDP Server Address"
    default "192.168.54.70:8000"
    depends on USE_AUDIO_DEBUGGER
    help
        UDP server address, format: IP:PORT

choice IOT_PROTOCOL
    prompt "IoT Protocol"
    default IOT_PROTOCOL_MCP
    help
        Device-control protocol exposed to the AI server.
    config IOT_PROTOCOL_MCP
        bool "MCP 2024-11-05"
endchoice

endmenu
```
